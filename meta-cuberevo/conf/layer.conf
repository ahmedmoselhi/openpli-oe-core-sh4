## meta-cuberevo/conf/layer.conf
```bitbake
# We have a conf and classes directory, append to BBPATH
BBPATH .= ":${LAYERDIR}"

# We have a recipes directory, add to BBFILES
BBFILES += "${LAYERDIR}/recipes-*/*.bb ${LAYERDIR}/recipes-*/*.bbappend \
            ${LAYERDIR}/recipes-*/*/*.bb ${LAYERDIR}/recipes-*/*/*.bbappend \
            ${LAYERDIR}/recipes-*/*/*/*.bb ${LAYERDIR}/recipes-*/*/*/*.bbappend"

BBFILE_COLLECTIONS += "cuberevo-layer"
BBFILE_PATTERN_cuberevo-layer := "^${LAYERDIR}/"
BBFILE_PRIORITY_cuberevo-layer = "7"

OEA-META-CUBEREVO-BASE := '${@os.path.normpath("${LAYERDIR}/")}'

# Additional license directories.
LICENSE_PATH += "${LAYERDIR}/conf/license"
```

## meta-cuberevo/conf/machine/cuberevo_2000hd.conf
```bitbake
require conf/machine/include/oem-cuberevo.inc

MACHINE_FEATURES += "ci cuberevo_2000hd"
```

## meta-cuberevo/conf/machine/cuberevo_3000hd.conf
```bitbake
require conf/machine/include/oem-cuberevo.inc

MACHINE_FEATURES += "cicuberevo_3000hd"
```

## meta-cuberevo/conf/machine/cuberevo_9500hd.conf
```bitbake
require conf/machine/include/oem-cuberevo.inc

MACHINE_FEATURES += "ci twintuner cuberevo_9500hd"
```

## meta-cuberevo/conf/machine/cuberevo_mini.conf
```bitbake
require conf/machine/include/oem-cuberevo.inc

MACHINE_FEATURES += "ci cuberevo_mini"
```

## meta-cuberevo/conf/machine/cuberevo_mini_fta.conf
```bitbake
require conf/machine/include/oem-cuberevo.inc

MACHINE_FEATURES += "cuberevo_mini_fta"
```

## meta-cuberevo/conf/machine/include/oem-cuberevo.inc
```bitbake
# We know about rtc
include conf/machine/include/build-extras.inc

BRAND_OEM = "cuberevo"

IMAGEDIR ?= "enigma2"
IMAGE_FSTYPES += "tar.gz"

AUDIOELF = "audio_7100.elf"
VIDEOELF = "video_7109.elf"

SOC_FAMILY = "sti7109"

DVB1FIRMWARE = "dvb-fe-cx24116.fw"
DVB2FIRMWARE = "dvb-fe-stv6306.fw"

KERNEL_MODULE_PACKAGE_SUFFIX = ""

MACHINE_KERNEL_PR = "r1"

TARGET_ARCH = "sh4"
DEFAULTTUNE = "sh4"

GLIBCVERSION = "2.23"
GCCVERSION = "4.9.4"

PREFERRED_PROVIDER_virtual/kernel = "linux-${BRAND_OEM}"
PREFERRED_VERSION_linux-libc-headers = "2.6.32"
OLDEST_KERNEL = "2.6.32"
PREFERRED_VERSION_8812au = "4.3.14"
PREFERRED_VERSION_samba = "3.%"
PREFERRED_PROVIDER_lirc = "stlirc"
PREFERRED_PROVIDER_virtual/egl = "libstgles"
PREFERRED_PROVIDER_virtual/libgles1 = "libstgles"
PREFERRED_PROVIDER_virtual/enigma2-mediaservice ?= "enigma2-plugin-systemplugins-servicemp3epl"

SERIAL_CONSOLE = "115200 ttyAS0"

DVBPROVIDER = "kernel"

MACHINE_FEATURES += "ext2 serial switchoff textlcd singlecore legacykernel usbconsole wlan modutils-${BRAND_OEM} cuberevo"
DISTRO_FEATURES_append += "libsigc2"

DVBMEDIASINK_CONFIG = "--with-wma --with-wmv --with-pcm --with-eac3"

KERNEL_IMAGETYPE = "uImage"
#KERNEL_OUTPUT = "${KERNEL_IMAGETYPE}"

# Add uImage in tar image boot directory
IMAGE_CMD_tar_prepend = "\
    cp ${DEPLOY_DIR_IMAGE}/uImage ${IMAGE_ROOTFS}/boot/${KERNEL_FILE}; \
    "

MACHINE_EXTRA_RRECOMMENDS += "\
    enigma2-plugin-systemplugins-serviceapp \
    "

MACHINE_ESSENTIAL_EXTRA_RDEPENDS += "\
    evremote2 \
    stlinux24-sh4-stx7109-fdma-firmware \
    firmware-sh4 \
    libmme-host \
    libmme-image \
    stslave-fw \
    ustslave \
    stfbcontrol \
    fp-control \
    stinit \
    ${BRAND_OEM}-dvb-modules \
    "

MACHINE_ESSENTIAL_EXTRA_RRECOMMENDS += "\
    kernel-module-mt7601usta \
    firmware-mt7601u \
    kernel-module-rt5572sta \
    firmware-rt2870 \
    kernel-module-r8812au \
    kernel-module-r8188eu \
    firmware-rtl8188eu \
    kernel-module-8192eu \
    firmware-rtl8192eu \
    "

EXTRA_IMAGEDEPENDS += "\
    libpcre \
    "

MACHINE_EXTRA_RDEPENDS += "\
    libpcre \
    "

include conf/machine/include/autoload-filesystems.inc
require conf/machine/include/tune-sh4.inc
require conf/machine/include/soc-family.inc
```

## meta-cuberevo/conf/machine/include/wifi-sh4.inc
```bitbake
MACHINE_ESSENTIAL_EXTRA_RRECOMMENDS += "\
	firmware-carl9170 \
	firmware-htc7010 \
	firmware-htc9271 \
	firmware-mt7601u \
	firmware-rt2870 \
	firmware-rt73 \
	firmware-rt3070 \
	firmware-rtl8188eu \
	firmware-rtl8192cu \
	firmware-rtl8712u \
	firmware-rtl8xxxu \
	firmware-zd1211 \
	\
	kernel-module-ath \
	kernel-module-ar9170usb \
	kernel-module-rtl8187 \
	kernel-module-zd1211rw \
	\
	kernel-module-8723a \
	kernel-module-mt7601usta \
	kernel-module-r8188eu \
	kernel-module-r8723bs \
	kernel-module-rt5572sta \
	"
```

## meta-spiderbox/conf/layer.conf
```bitbake
# We have a conf and classes directory, append to BBPATH
BBPATH .= ":${LAYERDIR}"

# We have a recipes directory, add to BBFILES
BBFILES += "${LAYERDIR}/recipes-*/*.bb ${LAYERDIR}/recipes-*/*.bbappend \
            ${LAYERDIR}/recipes-*/*/*.bb ${LAYERDIR}/recipes-*/*/*.bbappend \
            ${LAYERDIR}/recipes-*/*/*/*.bb ${LAYERDIR}/recipes-*/*/*/*.bbappend"

BBFILE_COLLECTIONS += "spiderbox-layer"
BBFILE_PATTERN_spiderbox-layer := "^${LAYERDIR}/"
BBFILE_PRIORITY_spiderbox-layer = "7"

OEA-META-SPIDERBOX-BASE := '${@os.path.normpath("${LAYERDIR}/")}'

# Additional license directories.
LICENSE_PATH += "${LAYERDIR}/conf/license"
```

## meta-spiderbox/conf/machine/include/oem-spiderbox.inc
```bitbake
# We know about rtc
include conf/machine/include/build-extras.inc
require conf/machine/include/wifi-sh4.inc

BRAND_OEM = "spiderbox"

IMAGEDIR ?= "enigma2"
IMAGE_FSTYPES += "tar.gz"

AUDIOELF = "audio_7100.elf"
VIDEOELF = "video_7109.elf"

SOC_FAMILY = "sti7109"

DVB1FIRMWARE = "dvb-fe-avl2108.fw"
DVB2FIRMWARE = "dvb-fe-stv6306.fw"

KERNEL_MODULE_PACKAGE_SUFFIX = ""

MACHINE_KERNEL_PR = "r1"

TARGET_ARCH = "sh4"
DEFAULTTUNE = "sh4"

GLIBCVERSION = "2.23"
GCCVERSION = "4.9.4"

PREFERRED_PROVIDER_virtual/kernel = "linux-${BRAND_OEM}"
PREFERRED_VERSION_linux-libc-headers = "2.6.32"
OLDEST_KERNEL = "2.6.32"
PREFERRED_VERSION_rt8812au = "4.3.14"
PREFERRED_VERSION_samba = "3.%"
PREFERRED_PROVIDER_lirc = "stlirc"
PREFERRED_PROVIDER_virtual/egl = "libstgles"
PREFERRED_PROVIDER_virtual/libgles1 = "libstgles"
PREFERRED_PROVIDER_virtual/enigma2-mediaservice ?= "enigma2-plugin-systemplugins-servicemp3epl"

SERIAL_CONSOLE = "115200 ttyAS0"

DVBPROVIDER = "kernel"

MACHINE_FEATURES += "ext2 serial switchoff textlcd singlecore legacykernel usbconsole wlan modutils-${BRAND_OEM} spiderbox"
DISTRO_FEATURES_append += "libsigc2"

DVBMEDIASINK_CONFIG = "--with-wma --with-wmv --with-pcm --with-eac3"

KERNEL_IMAGETYPE = "uImage"
#KERNEL_OUTPUT = "${KERNEL_IMAGETYPE}"

# Add uImage in tar image boot directory
IMAGE_CMD_tar_prepend = "\
    cp ${DEPLOY_DIR_IMAGE}/uImage ${IMAGE_ROOTFS}/boot/${KERNEL_FILE}; \
    "

MACHINE_EXTRA_RRECOMMENDS += "\
    enigma2-plugin-systemplugins-serviceapp \
    "

MACHINE_ESSENTIAL_EXTRA_RDEPENDS += "\
    stlirc \
    stlinux24-sh4-stx7109-fdma-firmware \
    firmware-sh4 \
    libmme-host \
    libmme-image \
    stslave-fw \
    ustslave \
    stfbcontrol \
    fp-control \
    stinit \
    ${BRAND_OEM}-dvb-modules \
    "

EXTRA_IMAGEDEPENDS += "\
    libpcre \
    "

MACHINE_EXTRA_RDEPENDS += "\
    libpcre \
    "

include conf/machine/include/autoload-filesystems.inc
require conf/machine/include/tune-sh4.inc
require conf/machine/include/soc-family.inc
```

## meta-spiderbox/conf/machine/include/wifi-sh4.inc
```bitbake
MACHINE_ESSENTIAL_EXTRA_RRECOMMENDS += "\
	firmware-carl9170 \
	firmware-htc7010 \
	firmware-htc9271 \
	firmware-rt2870 \
	firmware-rt73 \
	firmware-rtl8712u \
	firmware-zd1211 \
	firmware-rtl8192cu \
	firmware-rt3070 \
	firmware-mt7601u \
	firmware-rtl8188eu \
	firmware-rtl8xxxu \
	kernel-module-rtl8187 \
	kernel-module-zd1211rw \
	kernel-module-ar9170usb \
	kernel-module-rt2500usb \
	kernel-module-rt73usb \
	kernel-module-rt2800usb \
	kernel-module-ath \
	kernel-module-rt2x00usb \
	kernel-module-rt2x00lib \
	kernel-module-mt7601usta \
	kernel-module-rt2870sta \
	kernel-module-rt3070sta \
	kernel-module-rt5370sta \
	kernel-module-8188eu \
	kernel-module-8192cu \
	kernel-module-8712u \
	rtl8723a \
	rtl8723bs \
	rt8812au \
	rtl8192eu \
	rt7777-legacy \
"
```
